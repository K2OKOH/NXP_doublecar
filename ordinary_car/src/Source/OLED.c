#include "include.h"

#define OLED_DC         PTC19_OUT  
#define OLED_RST	PTC18_OUT 
#define OLED_SDA	PTC17_OUT  
#define OLED_SCL	PTC16_OUT  

#define X_WIDTH 128
#define Y_WIDTH 64

//======================================
const uint8 F6x8[][6] =
{
    { 0x00, 0x00, 0x00, 0x00, 0x00, 0x00 },   // sp
    { 0x00, 0x00, 0x00, 0x2f, 0x00, 0x00 },   // !
    { 0x00, 0x00, 0x07, 0x00, 0x07, 0x00 },   // "
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    { 0x14, 0x14, 0x14, 0x14, 0x14, 0x14 }    // horiz lines
};
void OLED_WrDat(unsigned char data)
{
  unsigned char i=8;
  //OLED_CS=0;
  OLED_DC=1;
  OLED_SCL=0;
  //asm("nop");    
  while(i--)
  {
    if(data&0x80){OLED_SDA=1;}
    else{OLED_SDA=0;}
    OLED_SCL=1; 
    asm("nop");
		//asm("nop");            
    OLED_SCL=0;   
    data<<=1;    
  }
	//OLED_CS=1;
}
void OLED_WrCmd(unsigned char cmd)
{
  unsigned char i=8;
  //OLED_CS=0;;
  OLED_DC=0;
  OLED_SCL=0;
  //asm("nop");   
  while(i--)
  {
    if(cmd&0x80){OLED_SDA=1;}
    else{OLED_SDA=0;}
    OLED_SCL=1;
    asm("nop");
		//asm("nop");             
    OLED_SCL=0;  
    cmd<<=1;  
  } 	
	//OLED_CS=1;
}
void OLED_Set_Pos(unsigned char x, unsigned char y)
{ 
  OLED_WrCmd(0xb0+y);
  OLED_WrCmd(((x&0xf0)>>4)|0x10);
  OLED_WrCmd((x&0x0f)|0x01); 
} 
void OLED_Fill(unsigned char bmp_data)
{
	unsigned char y,x;
	
	for(y=0;y<8;y++)
	{
		OLED_WrCmd(0xb0+y);
		OLED_WrCmd(0x01);
		OLED_WrCmd(0x10);
		for(x=0;x<X_WIDTH;x++)
			OLED_WrDat(bmp_data);
	}
}
void OLED_CLS(void)
{
	unsigned char y,x;	
	for(y=0;y<8;y++)
	{
		OLED_WrCmd(0xb0+y);
		OLED_WrCmd(0x01);
		OLED_WrCmd(0x10); 
		for(x=0;x<X_WIDTH;x++)
			OLED_WrDat(0);
	}
}
void OLED_DLY_ms(unsigned int ms)
{                         
  unsigned int a;
  while(ms)
  {
    a=1335;
    while(a--);
    ms--;
  }
  //delayms(ms);
  return;
}
void OLED_Init(void)        
{ 
    //-----端口初始化----//
    GPIO_Init(PTC,19,GPO,0);
    GPIO_Init(PTC,18,GPO,0);
    GPIO_Init(PTC,17,GPO,0);
    GPIO_Init(PTC,16,GPO,0);  
      
    OLED_SCL=1;
    //OLED_CS=1;	//预制SLK和SS为高电平               
    OLED_RST=0;
    OLED_DLY_ms(50);
    OLED_RST=1;

    OLED_WrCmd(0xae);//--turn off oled panel
    OLED_WrCmd(0x00);//---set low column address
    OLED_WrCmd(0x10);//---set high column address
    OLED_WrCmd(0x40);//--set start line address  Set Mapping RAM Display Start Line (0x00~0x3F)
    OLED_WrCmd(0x81);//--set contrast control register
    OLED_WrCmd(0xcf); // Set SEG Output Current Brightness
    OLED_WrCmd(0xa1);//--Set SEG/Column Mapping     0xa0左右反置 0xa1正常
    OLED_WrCmd(0xc8);//Set COM/Row Scan Direction   0xc0上下反置 0xc8正常
    OLED_WrCmd(0xa6);//--set normal display
    OLED_WrCmd(0xa8);//--set multiplex ratio(1 to 64)
    OLED_WrCmd(0x3f);//--1/64 duty
    OLED_WrCmd(0xd3);//-set display offset	Shift Mapping RAM Counter (0x00~0x3F)
    OLED_WrCmd(0x00);//-not offset
    OLED_WrCmd(0xd5);//--set display clock divide ratio/oscillator frequency
    OLED_WrCmd(0x80);//--set divide ratio, Set Clock as 100 Frames/Sec
    OLED_WrCmd(0xd9);//--set pre-charge period
    OLED_WrCmd(0xf1);//Set Pre-Charge as 15 Clocks & Discharge as 1 Clock
    OLED_WrCmd(0xda);//--set com pins hardware configuration
    OLED_WrCmd(0x12);
    OLED_WrCmd(0xdb);//--set vcomh
    OLED_WrCmd(0x40);//Set VCOM Deselect Level
    OLED_WrCmd(0x20);//-Set Page Addressing Mode (0x00/0x01/0x02)
    OLED_WrCmd(0x02);//
    OLED_WrCmd(0x8d);//--set Charge Pump enable/disable
    OLED_WrCmd(0x14);//--set(0x10) disable
    OLED_WrCmd(0xa4);// Disable Entire Display On (0xa4/0xa5)
    OLED_WrCmd(0xa6);// Disable Inverse Display On (0xa6/a7) 
    OLED_WrCmd(0xaf);//--turn on oled panel
    OLED_Fill(0x00);  //初始清屏
    OLED_Set_Pos(0,0);  
	
} 
void OLED_PutPixel(unsigned char x,unsigned char y)
{
	unsigned char data1;  //data1当前点的数据 

	OLED_Set_Pos(x,(unsigned char)(y>>3)); 
	data1 =(unsigned char)(0x01<<(y%8)); 	
	OLED_WrCmd((unsigned char)(0xb0+(y>>3)));
	OLED_WrCmd((unsigned char)(((x&0xf0)>>4)|0x10));
	OLED_WrCmd((unsigned char)((x&0x0f)|0x00));
	OLED_WrDat(data1); 	 	
}
void OLED_P6x8Str(unsigned char x,unsigned char y,unsigned char ch[])
{
  unsigned char c=0,i=0,j=0;      
  while (ch[j]!='\0')
  {    
    c =ch[j]-32;
    if(x>126){x=0;y++;}
    OLED_Set_Pos(x,y);    
  	for(i=0;i<6;i++)     
  	  OLED_WrDat(F6x8[c][i]);  
  	x+=6;
  	j++;
  }
}
void OLED_Print(unsigned char x, unsigned char y, unsigned char ch[])
{
	unsigned char ch2[3];
	unsigned char ii=0;        
	while(ch[ii] != '\0')
	{
		if(ch[ii] > 127)
		{
			ch2[0] = ch[ii];
	 		ch2[1] = ch[ii + 1];
			ch2[2] = '\0';			//汉字为两个字节
			OLED_P14x16Str(x , y, ch2);	//显示汉字
			x += 14;
			ii += 2;
		}
		else
		{
			ch2[0] = ch[ii];	
			ch2[1] = '\0';			//字母占一个字节
			OLED_P8x16Str(x , y , ch2);	//显示字母
			x += 8;
			ii+= 1;
		}
	}
} 

void OLED_PrintU16(unsigned char x,unsigned char y,unsigned int num)
{
	unsigned char tmp[6],i;
	tmp[5]=0;
	tmp[4]=(unsigned char)(num%10+0x30);
	tmp[3]=(unsigned char)(num/10%10+0x30);
	tmp[2]=(unsigned char)(num/100%10+0x30);
	tmp[1]=(unsigned char)(num/1000%10+0x30);
	tmp[0]=(unsigned char)(num/10000%10+0x30);
	
	for(i=0;i<4;i++)
	{
		if(tmp[i]=='0')
			tmp[i]=' ';
		else
			break;
	}
	
	OLED_P6x8Str(x,y,tmp);
	
}

void OLED_PrintFloat(unsigned char x,unsigned char y,float num)
{
	unsigned char tmp[6],i;
	tmp[5]=0;
	num *= 10;
	if(num>0)
	{
		tmp[0]='+';
		tmp[4]=(unsigned char)((int)num%10+0x30);
		tmp[3]=(unsigned char)((int)num/10%10+0x30);
		tmp[2]=(unsigned char)((int)num/100%10+0x30);
		tmp[1]=(unsigned char)((int)num/1000%10+0x30);
	}
	else
	{
		tmp[0]='-';
		num=-num;
		tmp[4]=(unsigned char)((int)num%10+0x30);
		tmp[3]=(unsigned char)((int)num/10%10+0x30);
		tmp[2]=(unsigned char)((int)num/100%10+0x30);
		tmp[1]=(unsigned char)((int)num/1000%10+0x30);
	}
	for(i=0;i<4;i++)
	{
		if(tmp[i]=='0')
			tmp[i]=' ';
		else
			break;
	}
	OLED_P6x8Str(x,y,tmp);
}

void OLED_ClrDot(unsigned char x)
{
	OLED_Set_Pos(x,6);
	OLED_WrCmd((unsigned char)(0xb0+6));
	OLED_WrCmd((unsigned char)(((x&0xf0)>>4)|0x10));
	OLED_WrCmd((unsigned char)((x&0x0f)|0x00));
	OLED_WrDat(0x00);
	
	OLED_Set_Pos(x,7);
	OLED_WrCmd((unsigned char)(0xb0+7));
	OLED_WrCmd((unsigned char)(((x&0xf0)>>4)|0x10));
	OLED_WrCmd((unsigned char)((x&0x0f)|0x00));
	OLED_WrDat(0x00);
} 
void Draw_Road(void)
{ 	
  int i = 0, j = 0,temp=0;
	for(i=0;i<56;i+=8)
	{
	  	OLED_Set_Pos(24,i/8);
	  	for(j=0;j<80;j++) 
	  	{ 
	  	  temp=0;
	  	  if(Copy_Image[0+i][j]) temp|=0x01;
	  	  if(Copy_Image[1+i][j]) temp|=0x02;
	  	  if(Copy_Image[2+i][j]) temp|=0x04;
	  	  if(Copy_Image[3+i][j]) temp|=0x08;
	  	  if(Copy_Image[4+i][j]) temp|=0x10;
	  	  if(Copy_Image[5+i][j]) temp|=0x20;
	  	  if(Copy_Image[6+i][j]) temp|=0x40;
	  	  if(Copy_Image[7+i][j]) temp|=0x80;
	  	  OLED_WrDat(temp); 	  	  	  	  
	  	}
	}           
}
void Draw_Frame(void)
{ 	
    OLED_Set_Pos(23,0);
    OLED_WrDat(0xFF); 
    OLED_Set_Pos(23,1);
    OLED_WrDat(0xFF); 
    OLED_Set_Pos(23,2);
    OLED_WrDat(0xFF); 
    OLED_Set_Pos(23,3);
    OLED_WrDat(0xFF); 
    OLED_Set_Pos(23,4);
    OLED_WrDat(0xFF); 
    OLED_Set_Pos(23,5);
    OLED_WrDat(0xFF);
    OLED_Set_Pos(23,6);
    OLED_WrDat(0xFF);
    
    OLED_Set_Pos(104,0);
    OLED_WrDat(0xFF); 
    OLED_Set_Pos(104,1);
    OLED_WrDat(0xFF); 
    OLED_Set_Pos(104,2);
    OLED_WrDat(0xFF); 
    OLED_Set_Pos(104,3);
    OLED_WrDat(0xFF); 
    OLED_Set_Pos(104,4);
    OLED_WrDat(0xFF); 
    OLED_Set_Pos(104,5);
    OLED_WrDat(0xFF);
    OLED_Set_Pos(104,6);
    OLED_WrDat(0xFF);
}
